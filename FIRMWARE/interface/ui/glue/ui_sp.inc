#MP If 0; Comment
/**
Copyright 2009 by Dresser, Inc., as an unpublished work.  All rights reserved.

This document and all information herein are the property of Dresser, Inc.
It and its contents are  confidential and have been provided as a part of
a confidential relationship.  As such, no part of it may be made public,
decompiled, reverse engineered or copied and it is subject to return upon
demand.

    \file ui_sp.inc
    \brief Macros to support UI position setpoint

    CPU: Any

    OWNER: AK

    $Archive: /MNCB/Dev/LCX2AP/FIRMWARE/interface/ui/glue/ui_sp.inc $
    $Date: 1/06/12 3:16p $
    $Revision: 1 $
    $Author: Arkkhasin $

*/
/* $History: ui_sp.inc $
 * 
 * *****************  Version 1  *****************
 * User: Arkkhasin    Date: 1/06/12    Time: 3:16p
 * Created in $/MNCB/Dev/LCX2AP/FIRMWARE/interface/ui/glue
 * First check-in of UI wiring adapted to UI module and LCX codebase
 * 
 * *****************  Version 3  *****************
 * User: Arkkhasin    Date: 4/08/09    Time: 3:18p
 * Updated in $/MNCB/Dev/FIRMWARE/interface/ui/glue
 * Repaired AP and ESD builds
 *
 * *****************  Version 2  *****************
 * User: Arkkhasin    Date: 4/08/09    Time: 11:02a
 * Updated in $/MNCB/Dev/FIRMWARE/interface/ui/glue
 * Oops - didn't compile
 *
 * *****************  Version 1  *****************
 * User: Arkkhasin    Date: 4/07/09    Time: 10:18p
 * Created in $/MNCB/Dev/FIRMWARE/interface/ui/glue
 * Compartmentalizing the UI glue layer
*/
#MP Endif

#MP ;Put the macros here