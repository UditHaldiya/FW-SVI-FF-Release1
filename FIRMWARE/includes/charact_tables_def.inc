#MP If 0 ;Tombstone header
/**
Copyright 2004 by Dresser, Inc., as an unpublished work.  All rights reserved.

This document and all information herein are the property of Dresser, Inc.
It and its contents are  confidential and have been provided as a part of
a confidential relationship.  As such, no part of it may be made public,
decompiled, reverse engineered or copied and it is subject to return upon
demand.

    \file charact_tables_gen.inc
    \brief Unimal definitions of const characterization tables.

    This is the only place where the definitions can be edited. Follow
    the example in defining them.
    For gory details, study the macros in charact_tables_gen.inc

    CPU: Any

    OWNER: AK
    \n RCS: $Id: $
     $DateTime: $ $Change: $ $Author: AK$
*/
#MP Endif ;Tombstone header
#MP
#MP Expand CharactTables()
#MP     Expand StartCharactTable(#@Hall#)
#MP         Expand DefineCharactPoint(0, 0)         ;0 degrees angle
#MP         Expand DefineCharactPoint(2397, 2412)   ;11
#MP         Expand DefineCharactPoint(3881, 3946)   ;18
#MP         Expand DefineCharactPoint(5109, 5262)   ;24
#MP         Expand DefineCharactPoint(6089, 6358)   ;29
#MP         Expand DefineCharactPoint(7023, 7454)   ;34
#MP         Expand DefineCharactPoint(7733, 8331)   ;38
#MP         Expand DefineCharactPoint(8404, 9208)   ;42
#MP         Expand DefineCharactPoint(9035, 10085)  ;46
#MP         Expand DefineCharactPoint(9479, 10743)  ;49
#MP         Expand DefineCharactPoint(9897, 11400)  ;52
#MP         Expand DefineCharactPoint(10289, 12058) ;55
#MP         Expand DefineCharactPoint(10651, 12716) ;58
#MP         Expand DefineCharactPoint(10985, 13373) ;61
#MP         Expand DefineCharactPoint(11289, 14031) ;64
#MP         Expand DefineCharactPoint(11562, 14689) ;67
#MP         Expand DefineCharactPoint(11803, 15346) ;70
#MP     Expand EndCharactTable()
#MP Expand EndCharactTables()
#MP
#MP ;/* This line marks the end of the source */

